## mimxrt700evk_cm33_core0/Kconfig.trace
```kconfig
config CUSTOM_APP_LVGL_GUIDER
    bool
    default y
    select MCUX_PRJSEG_config.arm.warn_as_error
    select MCUX_PRJSEG_config.arm.shared
    select MCUX_PRJSEG_config.rt.shared
    select MCUX_PRJSEG_config.device_core.define
    select MCUX_PRJSEG_config.arm.core.fpu.fpv5_sp
    select MCUX_PRJSEG_config.arm.core.cm33
    select MCUX_COMPONENT_CMSIS_Include_core_cm
    select MCUX_PRJSEG_module.device.suite
    select MCUX_COMPONENT_driver.video-common
    select MCUX_COMPONENT_driver.dc-fb-common
    select MCUX_COMPONENT_driver.dbi
    select MCUX_COMPONENT_driver.dbi_flexio_edma
    select MCUX_COMPONENT_driver.dbi_lcdif
    select MCUX_COMPONENT_driver.display-mipi-dsi-cmd
```
